## arch/ish/Kconfig
```kconfig
config ISH
	def_bool y
	select GENERIC_ATOMIC64
	select GENERIC_IRQ_SHOW
	select THREAD_INFO_IN_TASK
	select HAVE_FUTEX_CMPXCHG
	select VMALLOC_BROKEN
	select HAVE_COPY_THREAD_TLS
	select SYSCTL_EXCEPTION_TRACE
	select GENERIC_SCHED_CLOCK
	select GENERIC_CPU_DEVICES
	select GENERIC_CLOCKEVENTS
	select ARCH_USE_QUEUED_RWLOCKS
	select ARCH_USE_QUEUED_SPINLOCKS

config ISH_MAIN
	bool
	default y

config ISH_EMULATOR
	string
	default ishemu

config ARCH_RANDOM
	def_bool y
	prompt "Host random number generator" if EXPERT

config ARCH_KALLSYMS
	depends on KALLSYMS
	def_bool y

config LOCKDEP_SUPPORT
	def_bool y
config STACKTRACE_SUPPORT
	def_bool y
config TRACE_IRQFLAGS_SUPPORT
	def_bool y

# ABI vore
config 64BIT
	bool
	default y
config COMPAT
	def_bool y
config IA32_EMULATION
	def_bool y
config SYSVIPC_COMPAT
	def_bool y
	depends on SYSVIPC

config MMU
	bool
	default y

config SMP
	bool "Symmetric multi-processing support"
	default y
config NR_CPUS
	int "Maximum number of CPUs"
	range 2 32
	depends on SMP
	default 8

config HZ
	int "HZ"
	default 100

config PGTABLE_LEVELS
	int
	default 3

config NO_DMA
	def_bool y
config NO_IOMEM
	def_bool y
config NO_VMALLOC
	def_bool y
config GENERIC_HWEIGHT
	def_bool y
config GENERIC_CSUM
	def_bool y

config HOSTFS
	bool "Host filesystem"

config HOST_INET
	bool "Host-based AF_INET"
	default y
	depends on NET && !INET

config GOLP
	bool "Golp interface"
	default y
	depends on INET
```

## arch/ish/Kconfig.debug
```kconfig
config EARLY_PRINTK
	bool "Early printk"
	default y

config ARCH_WANT_FRAME_POINTERS
	default y if DEBUG_INFO
```

## arch/ish/configs/ish_defconfig
```kconfig
CONFIG_SYSVIPC=y
CONFIG_POSIX_MQUEUE=y
CONFIG_NO_HZ_IDLE=y
CONFIG_HIGH_RES_TIMERS=y
CONFIG_CGROUPS=y
CONFIG_MEMCG=y
CONFIG_BLK_CGROUP=y
CONFIG_CGROUP_SCHED=y
CONFIG_CFS_BANDWIDTH=y
CONFIG_CGROUP_PIDS=y
CONFIG_CGROUP_FREEZER=y
CONFIG_CGROUP_DEVICE=y
CONFIG_CGROUP_CPUACCT=y
CONFIG_CGROUP_DEBUG=y
CONFIG_NAMESPACES=y
CONFIG_BLK_DEV_INITRD=y
# CONFIG_RD_GZIP is not set
# CONFIG_RD_BZIP2 is not set
# CONFIG_RD_LZMA is not set
# CONFIG_RD_XZ is not set
# CONFIG_RD_LZO is not set
# CONFIG_RD_LZ4 is not set
CONFIG_EXPERT=y
# CONFIG_KALLSYMS is not set
CONFIG_HOSTFS=y
# CONFIG_BLK_DEV_BSG is not set
CONFIG_BLK_DEV_THROTTLING=y
CONFIG_NET=y
CONFIG_PACKET=y
CONFIG_UNIX=y
CONFIG_INET=y
CONFIG_IP_PNP=y
# CONFIG_IPV6 is not set
CONFIG_NETFILTER=y
CONFIG_BRIDGE_NETFILTER=y
CONFIG_NF_CONNTRACK=y
CONFIG_NF_CT_NETLINK=y
CONFIG_NETFILTER_XT_TARGET_MASQUERADE=y
CONFIG_NETFILTER_XT_MATCH_ADDRTYPE=y
CONFIG_NETFILTER_XT_MATCH_CONNTRACK=y
CONFIG_IP_NF_IPTABLES=y
CONFIG_IP_NF_FILTER=y
CONFIG_IP_NF_NAT=y
CONFIG_BRIDGE=y
CONFIG_CGROUP_NET_PRIO=y
CONFIG_CGROUP_NET_CLASSID=y
# CONFIG_WIRELESS is not set
# CONFIG_ETHTOOL_NETLINK is not set
CONFIG_DEVTMPFS=y
CONFIG_DEVTMPFS_MOUNT=y
# CONFIG_FW_LOADER is not set
CONFIG_BLK_DEV_LOOP=y
CONFIG_BLK_DEV_RAM=y
CONFIG_NETDEVICES=y
CONFIG_VETH=y
# CONFIG_ETHERNET is not set
# CONFIG_WLAN is not set
# CONFIG_INPUT is not set
# CONFIG_SERIO is not set
# CONFIG_VT is not set
CONFIG_RANDOM_TRUST_CPU=y
CONFIG_EXT4_FS=y
CONFIG_EXT4_FS_POSIX_ACL=y
CONFIG_EXT4_FS_SECURITY=y
CONFIG_OVERLAY_FS=y
CONFIG_TMPFS=y
CONFIG_TMPFS_POSIX_ACL=y
# CONFIG_NETWORK_FILESYSTEMS is not set
# CONFIG_CRYPTO_HW is not set
CONFIG_PRINTK_TIME=y
CONFIG_MAGIC_SYSRQ=y
CONFIG_PANIC_TIMEOUT=-1
```
